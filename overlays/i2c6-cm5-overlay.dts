/dts-v1/;
/plugin/;

/ {
    compatible = "brcm,bcm2712";

    fragment@0 {
        target = <&i2c6>;
        __overlay__ {
            status = "okay";
            clock-frequency = <400000>;
            pinctrl-names = "default";
            pinctrl-0 = <&rp1_i2c6_38_39>;
            symlink = "i2c-0";
        };
    };
};
